// SPDX-License-Identifier: (GPL-2.0+ OR MIT)

#include "rk3588-nanopc-t6.dts"

&hdmi0_sound {
 	status = "okay";
};

&hdmi1_sound {
	status = "okay";
};

&i2s5_8ch {
 	status = "okay";
};

&i2s6_8ch {
	status = "okay";
};
